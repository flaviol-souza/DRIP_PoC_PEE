#include "drone_playback.h"
#include "drone_data.h"          // generated by csv_to_drone_data.py
#include <Arduino.h>
#include <math.h>
#include <string.h>

// ---------------------------------------------------------------------------
// State
// ---------------------------------------------------------------------------
static bool     g_ready     = false;
static uint16_t g_flight    = 0;   // selected flight index
static uint16_t g_idx       = 0;   // index CURRENTLY being broadcast (already "arrived")
static bool     g_finished  = false;
static bool     g_stopped_by_user = false;  // true if halted via 'stop', not end-of-track
static bool     g_started   = false;   // false until the first point has been emitted

// Real-timestamp pacing state (Option A: hold each recorded point for its real
// recorded duration, instead of one point per fixed 0.333 s cycle).
static float    g_hold_elapsed_s = 0;   // TX seconds accumulated while holding g_idx
static uint32_t g_last_call_ms   = 0;   // millis() at the previous call, for MEASURED pacing
// Velocity that carried the drone INTO g_idx (i.e. from g_idx-1 to g_idx), held
// constant on the wire while broadcast waits for real time to reach the next
// recorded point. Zero for the first point of a track (no prior point to derive it).
static float    g_cur_speed   = 0;
static float    g_cur_vspeed  = 0;
static float    g_cur_heading = 0;

// If two consecutive recorded points share the same (or an out-of-order)
// timestamp, there is no real interval to pace against. Advance immediately
// using this floor instead of stalling forever. This is common in the source
// data: several rows can carry the same integer-second timestamp.
#define PLAYBACK_MIN_DT_S   PLAYBACK_CYCLE_S

// Read one point from flash (the tables live in PROGMEM, not RAM).
// `ts_unix` receives the RECORDED timestamp (test-only; see drone_playback.h).
static bool read_point(uint16_t flight, uint16_t i,
                       double *lat, double *lon, float *alt_m, uint32_t *ts_unix) {
    if (flight >= DRONE_FLIGHT_COUNT || i >= DRONE_FLIGHTS[flight].n) return false;
    const DronePoint *p = &DRONE_FLIGHTS[flight].pts[i];
    int32_t lat_e7 = (int32_t)pgm_read_dword(&p->lat_e7);
    int32_t lon_e7 = (int32_t)pgm_read_dword(&p->lon_e7);
    int16_t alt_dm = (int16_t)pgm_read_word(&p->alt_dm);
    *lat   = lat_e7 / 1e7;
    *lon   = lon_e7 / 1e7;
    *alt_m = alt_dm / 10.0f;
    if (ts_unix) *ts_unix = (uint32_t)pgm_read_dword(&p->ts_unix);
    return true;
}

// ---------------------------------------------------------------------------
void drone_playback_list() {
    Serial.println("[Playback] Available flights:");
    for (uint16_t i = 0; i < DRONE_FLIGHT_COUNT; i++) {
        // Real playback duration = last recorded timestamp - first recorded
        // timestamp (Option A: paced by real time, not by point count x 0.333 s).
        double dlat, dlon; float dalt;
        uint32_t ts0 = 0, ts1 = 0;
        read_point(i, 0, &dlat, &dlon, &dalt, &ts0);
        read_point(i, DRONE_FLIGHTS[i].n - 1, &dlat, &dlon, &dalt, &ts1);
        float secs = (DRONE_FLIGHTS[i].n > 1) ? (float)(ts1 - ts0) : 0.0f;
        Serial.printf("  %2u : %-20s %5u pts  (~%.1f min real time)%s\n",
                      i, DRONE_FLIGHTS[i].flight_id, DRONE_FLIGHTS[i].n, secs / 60.0f,
                      (g_ready && i == g_flight) ? "  <= selected" : "");
    }
    Serial.println("[Playback] Type a number to select, or 'list' | 'info' | 'next' | 'reset'.");
}

bool drone_playback_init() {
    g_ready = false;
    if (DRONE_FLIGHT_COUNT == 0) {
        Serial.println("[Playback] ERROR: drone_data.h contains no flights.");
        return false;
    }
    g_flight = 0;
    g_idx = 0;
    g_finished = false;
    g_stopped_by_user = false;
    g_started = false;
    g_hold_elapsed_s = 0;
    g_last_call_ms = 0;
    g_cur_speed = g_cur_vspeed = g_cur_heading = 0;
    g_ready = true;
    Serial.printf("[Playback] %u flight(s) compiled in.\n", DRONE_FLIGHT_COUNT);
#if DRONE_REPLAY_RECORDED_TIME
    Serial.println("[Playback] *** TEST MODE: replaying RECORDED timestamps in the ASTM");
    Serial.println("[Playback]     Location message (NOT RFC-conformant). DRIP VNB/VNA");
    Serial.println("[Playback]     remain on the live clock. Do not use in flight. ***");
#endif
    drone_playback_list();
    return true;
}

bool     drone_playback_ready()    { return g_ready; }
uint16_t drone_playback_count()    { return DRONE_FLIGHT_COUNT; }
bool     drone_playback_finished() { return g_finished; }

void drone_playback_reset() {
    g_idx = 0;
    g_finished = false;
    g_stopped_by_user = false;
    g_started = false;                         // next call re-emits point 0 fresh
    g_hold_elapsed_s = 0;
    g_last_call_ms = 0;                        // next call measures from a clean start
    g_cur_speed = g_cur_vspeed = g_cur_heading = 0;
}

// Halt transmission on demand (serial 'stop' command). Reuses the same
// end-of-track hold mechanism the .ino already gates on: drone_playback_finished()
// becomes true, so the .ino calls beacon_tx_stop() and stops building/signing
// packs. Distinguished from an end-of-track halt only for logging (g_stopped_by_user).
void drone_playback_stop() {
    if (g_finished) return;                    // already halted (end-of-track or stop)
    g_finished = true;
    g_stopped_by_user = true;
    Serial.println();
    Serial.println("===========================================================");
    Serial.printf ("[Playback] STOPPED by command at point %u/%u of flight %u (%s).\n",
                   g_idx, DRONE_FLIGHTS[g_flight].n, g_flight, DRONE_FLIGHTS[g_flight].flight_id);
    Serial.println("[Playback] Transmission STOPPED - no Remote ID is on the air.");
    Serial.println("[Playback] Choose a flight to start transmitting again:");
    Serial.println("             <number>   select and start that flight");
    Serial.println("             reset      replay the current flight");
    Serial.println("             list       show all flights");
    Serial.println("===========================================================");
    drone_playback_list();
}

bool drone_playback_select(uint16_t index) {
    if (!g_ready || index >= DRONE_FLIGHT_COUNT) return false;
    g_flight = index;
    drone_playback_reset();
    Serial.printf("[Playback] Selected flight %u: %s (%u points, ~%.1f min)\n",
                  index, DRONE_FLIGHTS[index].flight_id, DRONE_FLIGHTS[index].n,
                  DRONE_FLIGHTS[index].n * PLAYBACK_CYCLE_S / 60.0f);
    return true;
}

const uint8_t *drone_playback_det() {
    // nullptr -> the caller uses the shared UA DET (current PoC behaviour).
    // Fill the `det` field in drone_data.h to give a flight its own identity.
    return g_ready ? DRONE_FLIGHTS[g_flight].det : nullptr;
}

void drone_playback_get_launch(double *lat, double *lon, float *alt_m) {
    if (!g_ready || !read_point(g_flight, 0, lat, lon, alt_m, nullptr)) {
        *lat = 0; *lon = 0; *alt_m = 0;
    }
}

// ---------------------------------------------------------------------------
// Advance one point; derive speed / heading / vertical speed from the delta.
// At the end of the track, hold on the last point with zero velocity.
// ---------------------------------------------------------------------------
// Great-circle-free distance between two points, accurate over the metre-scale
// hops between consecutive recorded samples (equirectangular approximation).
static double point_distance_m(double lat1, double lon1, double lat2, double lon2) {
    const double M_PER_DEG_LAT = 111320.0;
    double mean_lat_rad = radians((lat1 + lat2) * 0.5);
    double dy = (lat2 - lat1) * M_PER_DEG_LAT;                      // north (m)
    double dx = (lon2 - lon1) * M_PER_DEG_LAT * cos(mean_lat_rad);  // east  (m)
    return sqrt(dx * dx + dy * dy);
}

DronePosition drone_playback_next(uint32_t live_unix_time_s) {
    DronePosition pos;
    pos.lat = 0; pos.lon = 0; pos.alt_m = 0;
    pos.speed_mps = 0; pos.vspeed_mps = 0; pos.heading_deg = 0;
    pos.unix_time_s = live_unix_time_s;
    if (!g_ready) return pos;

    const uint16_t n = DRONE_FLIGHTS[g_flight].n;
    uint16_t i = g_finished ? (uint16_t)(n - 1) : g_idx;      // hold on the last point

    double lat, lon; float alt_m; uint32_t ts_rec = 0;
    if (!read_point(g_flight, i, &lat, &lon, &alt_m, &ts_rec)) return pos;

    // ---- Real-timestamp pacing (Option A) ------------------------------------
    // Advance to the next recorded point only once real transmission time has
    // caught up to the REAL recorded interval between points, instead of one
    // point per fixed 0.333 s cycle. Speed/heading/vspeed are computed from the
    // actual recorded delta-t, so they reflect true average velocity over that
    // segment rather than being inflated by assuming a constant 0.333 s gap.
    // The velocity shown is held constant for the whole hold (it represents the
    // motion that carried the drone INTO the current point).
    //
    // BUG FIX: g_hold_elapsed_s used to be incremented by the ASSUMED cycle
    // duration (PLAYBACK_CYCLE_S = 0.333 s) every call, regardless of how long
    // the cycle actually took. loop()'s real period is delay(333) PLUS whatever
    // that cycle's processing costs (Ed25519 signing on Wrapper/Manifest cycles,
    // the Wi-Fi vendor-IE update, and especially verbose drip_debug serial
    // output) -- none of that was accounted for, so the internal pacing clock
    // silently drifted from real wall-clock time. Measured in practice: a
    // 700 s (11.7 min) flight took ~1440 s (24 min) to play back, a ~2.06x
    // drift, implying the real cycle was taking ~686 ms, not the assumed 333 ms.
    // Fix: measure the ACTUAL elapsed time via millis() and add THAT instead,
    // so pacing is correct regardless of how long any given cycle takes.
    uint32_t now_ms = millis();
    float real_elapsed_s = (g_last_call_ms == 0) ? PLAYBACK_CYCLE_S
                                                  : (now_ms - g_last_call_ms) / 1000.0f;
    g_last_call_ms = now_ms;

    if (!g_started) {
        g_started = true;                  // first emission: no prior point yet
        g_hold_elapsed_s = 0;
        g_cur_speed = g_cur_vspeed = g_cur_heading = 0;
    } else if (!g_finished) {
        g_hold_elapsed_s += real_elapsed_s;   // MEASURED, not assumed
        if (g_idx + 1 < n) {
            double next_lat, next_lon; float next_alt; uint32_t next_ts;
            if (read_point(g_flight, g_idx + 1, &next_lat, &next_lon, &next_alt, &next_ts)) {
                double dt = (double)next_ts - (double)ts_rec;
                if (dt <= 0) dt = PLAYBACK_MIN_DT_S;   // duplicate/out-of-order timestamp guard
                if (g_hold_elapsed_s >= dt) {
                    double d = point_distance_m(lat, lon, next_lat, next_lon);
                    g_cur_speed   = (float)(d / dt);
                    g_cur_vspeed  = (next_alt - alt_m) / dt;
                    g_cur_heading = 0;
                    if (d > 0.01) {
                        double hdg = degrees(atan2(
                            (next_lon - lon) * 111320.0 * cos(radians((lat + next_lat) * 0.5)),
                            (next_lat - lat) * 111320.0));
                        if (hdg < 0) hdg += 360.0;
                        g_cur_heading = (float)hdg;
                    }
                    g_idx++;
                    g_hold_elapsed_s -= dt;            // carry the remainder forward
                    // re-read the point we just advanced to, so this cycle emits it
                    read_point(g_flight, g_idx, &lat, &lon, &alt_m, &ts_rec);
                }
            }
        }
    }

    pos.lat = lat; pos.lon = lon; pos.alt_m = alt_m;
    pos.speed_mps  = g_cur_speed;
    pos.vspeed_mps = g_cur_vspeed;
    pos.heading_deg = g_cur_heading;

#if DRONE_REPLAY_RECORDED_TIME
    // *** TEST-ONLY (see drone_playback.h) ***
    // Replay the dataset's RECORDED timestamp instead of the live clock. This
    // reaches ONLY the ASTM Location message timestamp (f3411_messages.cpp:
    // `(unix_time_s % 3600) * 10`, i.e. tenths of a second within the UTC hour).
    // DRIP VNB/VNA come from drip_timestamp() and stay on the live clock, so the
    // Wrapper / Link / Manifest signatures remain RFC 9575 §3.2.4.3 conformant.
    // A receiver checking the Location time against the real world will see a
    // stale value: acceptable on the bench, never in flight.
    pos.unix_time_s = ts_rec;
#else
    pos.unix_time_s = live_unix_time_s;   // RFC-conformant: broadcast time is now
#endif
    // When finished, velocity stays zero (aircraft reported as stationary).
    if (g_finished) { pos.speed_mps = 0; pos.vspeed_mps = 0; pos.heading_deg = 0; }

    // The track is complete once we have EMITTED the last index (n-1): there is
    // no next recorded timestamp left to pace against. Fires once, on the cycle
    // that first reaches/holds the final point.
    if (!g_finished && n > 0 && g_idx >= n - 1) {
        g_finished = true;
        // The .ino checks drone_playback_finished() and stops transmitting
        // (beacon_tx_stop()); we prompt the operator to pick the next flight.
        Serial.println();
        Serial.println("===========================================================");
        Serial.printf ("[Playback] FLIGHT COMPLETE: %u (%s), %u point(s) transmitted.\n",
                       g_flight, DRONE_FLIGHTS[g_flight].flight_id, n);
        Serial.println("[Playback] Transmission STOPPED - no Remote ID is on the air.");
        Serial.println("[Playback] Choose a flight to start transmitting again:");
        Serial.println("             <number>   select and start that flight");
        Serial.println("             reset      replay the current flight");
        Serial.println("             list       show all flights");
        Serial.println("===========================================================");
        drone_playback_list();
    }
    return pos;
}

// ---------------------------------------------------------------------------
// Serial commands — call once per loop().
// ---------------------------------------------------------------------------
void drone_playback_cmd() {
    if (!Serial.available()) return;

    char buf[32];
    size_t n = Serial.readBytesUntil('\n', buf, sizeof(buf) - 1);
    buf[n] = '\0';
    while (n && (buf[n - 1] == '\r' || buf[n - 1] == ' ')) buf[--n] = '\0';
    if (n == 0) return;

    if (strcasecmp(buf, "list") == 0) {
        drone_playback_list();
    } else if (strcasecmp(buf, "info") == 0) {
        if (g_ready)
            Serial.printf("[Playback] flight %u (%s), point %u/%u%s\n",
                          g_flight, DRONE_FLIGHTS[g_flight].flight_id,
                          g_idx, DRONE_FLIGHTS[g_flight].n,
                          g_finished ? (g_stopped_by_user ? "  [stopped by command]"
                                                          : "  [finished — holding]")
                                     : "");
        else
            Serial.println("[Playback] not initialised");
    } else if (strcasecmp(buf, "stop") == 0) {
        drone_playback_stop();
    } else if (strcasecmp(buf, "reset") == 0) {
        drone_playback_reset();
        Serial.println("[Playback] restarted at point 0");
    } else if (strcasecmp(buf, "next") == 0) {
        DronePosition p = drone_playback_next(0);
        Serial.printf("[Playback] -> lat=%.7f lon=%.7f alt=%.1f m spd=%.1f hdg=%.0f ts=%lu\n",
                      p.lat, p.lon, p.alt_m, p.speed_mps, p.heading_deg,
                      (unsigned long)p.unix_time_s);
    } else {
        char *end;
        long v = strtol(buf, &end, 10);
        if (end != buf && *end == '\0' && v >= 0) {
            if (!drone_playback_select((uint16_t)v))
                Serial.printf("[Playback] invalid index %ld (0..%u)\n", v, DRONE_FLIGHT_COUNT - 1);
        } else {
            Serial.printf("[Playback] unknown command '%s' (list | info | next | reset | stop | <number>)\n", buf);
        }
    }
}
